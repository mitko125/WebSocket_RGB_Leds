## sdkconfig.defaults
```kconfig
CONFIG_ESPTOOLPY_FLASHSIZE_4MB=y
CONFIG_PARTITION_TABLE_CUSTOM=y
CONFIG_PARTITION_TABLE_CUSTOM_FILENAME="partitions.csv"
CONFIG_PARTITION_TABLE_FILENAME="partitions.csv"
CONFIG_HTTPD_WS_SUPPORT=y

#
# зарди проблеми при Dynamic DNS и очаквани при https
#
CONFIG_HTTPD_MAX_URI_LEN=1024
CONFIG_HTTPD_MAX_REQ_HDR_LEN=1024

#
# without this HTTPS mysteriously doesn't get configured
#
CONFIG_ESP_HTTPS_SERVER_ENABLE=y
#
# Our certs are too big for 4096
#
CONFIG_MBEDTLS_SSL_OUT_CONTENT_LEN=8192
#
# това е от забележката към https_server_user_callback
#
CONFIG_ESP_TLS_SERVER_MIN_AUTH_MODE_OPTIONAL=y
#
# не желаеше да работи с повече от един SSL/TLS клиент при WebSocket
# не знам как ще е при ESP32 без външна RAM
#
CONFIG_MBEDTLS_EXTERNAL_MEM_ALLOC=y
#
# без тези Acme клиента препълва стека
#
CONFIG_SYSTEM_EVENT_TASK_STACK_SIZE=6144
CONFIG_MAIN_TASK_STACK_SIZE=6144
```

## sdkconfig.defaults.esp32s3
```kconfig
CONFIG_BLINK_LED_STRIP=y
CONFIG_BLINK_GPIO=48

CONFIG_SPIRAM=y
CONFIG_SPIRAM_MODE_OCT=y
CONFIG_SPIRAM_SPEED_80M=y

# Enabling the following configurations can help increase the PCLK frequency in the case when
# the Frame Buffer is allocated from the PSRAM and fetched by EDMA
CONFIG_SPIRAM_FETCH_INSTRUCTIONS=y
CONFIG_SPIRAM_RODATA=y

CONFIG_ESPTOOLPY_FLASHSIZE_16MB=y
```
